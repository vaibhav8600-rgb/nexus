## Kconfig
```kconfig
# NEXUS Smart ZMK Dongle
# Every user-facing knob lives here so integrators never edit NEXUS source.

menuconfig NEXUS
	bool "NEXUS smart dongle platform"
	depends on ZMK_SPLIT_ROLE_CENTRAL || !ZMK_SPLIT
	help
	  Display / UI / games / sound platform layered on top of ZMK.
	  Leave this off for keyboard-half (peripheral) builds: none of the
	  NEXUS code is compiled unless this is set.

if NEXUS

config NEXUS_BRAND
	string "Brand name shown on the splash and About screen"
	default "VAIBHAV TECH"

config NEXUS_PRODUCT
	string "Product name"
	default "NEXUS"

config NEXUS_SUBTITLE
	string "Product subtitle"
	default "SMART ZMK DONGLE"

config NEXUS_AUTHOR
	string "Creator credit shown on the About screen"
	default "VAIBHAV RAJPUT"
	help
	  Empty hides the line. Like every other name here this is a default,
	  not a constant in the source (Requirement B).

# --------------------------------------------------------------------------
# Display / UI
# --------------------------------------------------------------------------
config NEXUS_DISPLAY
	bool "NEXUS display UI"
	default y
	depends on ZMK_DISPLAY
	help
	  Renders the NEXUS UI as ZMK's custom status screen. ZMK owns the
	  display device and its work queue, so NEXUS adds no thread of its own.

	  The matching `choice ZMK_DISPLAY_STATUS_SCREEN` default is set by the
	  shield (boards/shields/nexus_dongle/Kconfig.defconfig). It cannot be
	  selected from here: Kconfig does not allow `select` on a member of a
	  choice, and doing so makes the build fail in a way that points
	  everywhere except at this line.

if NEXUS_DISPLAY

config NEXUS_THEME
	string "Default theme name"
	default "NEXUS"
	help
	  One of: NEXUS, AMOLED, DAYLIGHT, CLAY, ESPRESSO, MINT, SUNSET.
	  Unknown names fall back to NEXUS.

choice NEXUS_DEFAULT_SCREEN
	prompt "Screen shown after boot"
	default NEXUS_DEFAULT_SCREEN_HOME

config NEXUS_DEFAULT_SCREEN_HOME
	bool "Home dashboard"

config NEXUS_DEFAULT_SCREEN_GAME_CENTER
	bool "Game Center"

config NEXUS_DEFAULT_SCREEN_DIAGNOSTICS
	bool "Diagnostics"

endchoice

config NEXUS_DISPLAY_ROTATION
	int "Logical display rotation in degrees (0/90/180/270)"
	default 0
	help
	  Rotation is done by the NEXUS compositor while it pushes each band,
	  so all drawing stays in logical top-left coordinates and no screen
	  needs to know (Section 8).

	  Try the panel first: the ST7789 `mdac` byte in your shield overlay
	  rotates in the controller and costs nothing. Use this option when the
	  panel is mounted at an angle the controller cannot express. It is not
	  free - 90 and 270 transpose each band through a second 5,760-byte
	  buffer, which is RAM and cycles you get back by setting it to 0.

config NEXUS_ANIMATIONS
	bool "UI animations"
	default y

config NEXUS_UI_REFRESH_FAST_MS
	int "Fast (game / animation) UI period, ms"
	default 33

config NEXUS_UI_REFRESH_NORMAL_MS
	int "Normal (status) UI period, ms"
	default 200

config NEXUS_UI_REFRESH_IDLE_MS
	int "Idle UI period, ms"
	default 1000

config NEXUS_BACKLIGHT_TIMEOUT_S
	int "Blank the backlight after N idle seconds (0 = never)"
	default 0
	help
	  Never applied while a game is running or ZMK Studio is connected.

endif # NEXUS_DISPLAY

# --------------------------------------------------------------------------
# Splash (Sections 18-21)
# --------------------------------------------------------------------------
config NEXUS_SPLASH
	bool "Boot splash screen"
	default y
	depends on NEXUS_DISPLAY

if NEXUS_SPLASH

config NEXUS_SPLASH_DURATION_MS
	int "Splash duration in ms (0 disables)"
	default 3000

config NEXUS_SPLASH_DEFAULT_IMAGE
	string "Path to a splash PNG bundled with the module"
	depends on NEXUS_SPLASH
	default ""
	help
	  A PNG inside the NEXUS module itself, used when the integrator has
	  not supplied one of their own. Relative to the module root, so
	  "assets/splash.png" is the natural place.

	  Priority is NEXUS_SPLASH_IMAGE, then this, then the drawn badge.

	  Think before setting it. The drawn badge costs a few hundred bytes;
	  a 240x240 image costs 115,200 - about 14% of the app partition -
	  and every build of the module pays that whether or not the splash is
	  ever seen. It exists for someone shipping NEXUS pre-branded, not as
	  a better default.

config NEXUS_SPLASH_IMAGE
	string "Path to a splash PNG, relative to your zmk-config dir"
	default ""
	help
	  Converted to a native-endian RGB565 array at build time by
	  scripts/png2c.py and blitted by the compositor. Empty means use the
	  built-in NEXUS default artwork, which is drawn rather than stored and
	  follows the active theme.

config NEXUS_SPLASH_MAX_DIM
	int "Downscale splash artwork above this many pixels per side"
	default 160
	help
	  Guards flash: 240x240 RGB565 is 115 KB, 160x160 is 51 KB.

endif # NEXUS_SPLASH

# --------------------------------------------------------------------------
# Input
# --------------------------------------------------------------------------
config NEXUS_BUTTON
	bool "Physical action button"
	default y
	help
	  Requires an `action-button` node in devicetree (see the nexus_dongle
	  shield). Absent hardware degrades to "no button", never to a crash.

config NEXUS_BUTTON_DEBOUNCE_MS
	int "Action button debounce, ms"
	default 30
	depends on NEXUS_BUTTON

config NEXUS_BUTTON_LONG_PRESS_MS
	int "Long-press threshold, ms"
	default 600
	depends on NEXUS_BUTTON

config NEXUS_BEHAVIOR_ACTION
	bool "&nexus_action keymap behavior"
	default y
	help
	  Lets a keymap key dispatch the same logical actions as the physical
	  action button.

# --------------------------------------------------------------------------
# Sound (Sections 15-17, 48, 108)
# --------------------------------------------------------------------------
config NEXUS_SOUND
	bool "Passive buzzer sound engine"
	default y
	select PWM
	help
	  PWM-synthesised tones. Requires a `buzzer` PWM node in devicetree.

if NEXUS_SOUND

config NEXUS_UI_SOUND
	bool "UI sound effects"
	default y

config NEXUS_GAME_SOUND
	bool "Game sound effects"
	default y

config NEXUS_SOUND_STARTUP
	bool "Play the startup jingle"
	default y

endif # NEXUS_SOUND

# --------------------------------------------------------------------------
# Games (Sections 36-53)
# --------------------------------------------------------------------------
config NEXUS_GAME_CENTER
	bool "Game Center launcher"
	default y
	depends on NEXUS_DISPLAY
	select NEXUS_GAMES

config NEXUS_GAMES
	bool "Game engine"
	default n

config NEXUS_TETRIS
	bool "Tetris"
	default y
	depends on NEXUS_GAMES

config NEXUS_SNAKE
	bool "Snake"
	default y
	depends on NEXUS_GAMES
	help
	  Grid game, 24x24 cells. About 1.2 KB of RAM: the body is a ring of
	  cell indices plus an occupancy grid, so growing is O(1) and the
	  self-collision test is one array read.

config NEXUS_SNAKE_WRAP
	bool "Snake wraps at the edges instead of dying"
	default y
	depends on NEXUS_SNAKE
	help
	  The board is a torus. Fatal walls make a 24x24 board very
	  short-lived and turn the game into a test of not touching the frame
	  rather than of not touching yourself.

config NEXUS_SNAKE_TICK_MS
	int "Snake starting step interval, ms"
	default 160
	depends on NEXUS_SNAKE
	help
	  Lower is faster. 160 is a relaxed start; 110 is brisk.

config NEXUS_SNAKE_TICK_MIN_MS
	int "Snake fastest step interval, ms"
	default 70
	depends on NEXUS_SNAKE
	help
	  The floor the speed-up cannot pass. Below about 50 the snake moves
	  faster than a repaint, so input stops feeling connected to it.

config NEXUS_SNAKE_SPEED_EVERY
	int "Speed up after this many apples"
	default 4
	depends on NEXUS_SNAKE

config NEXUS_SNAKE_SPEED_STEP_MS
	int "Milliseconds removed per speed-up"
	default 10
	depends on NEXUS_SNAKE

config NEXUS_BREAKOUT
	bool "Breakout"
	default y
	depends on NEXUS_GAMES
	help
	  Paddle and ball. Positions are 8.8 fixed point rather than whole
	  pixels, because integer motion would force the ball to travel at
	  least a pixel per tick - far too fast at any playable frame rate -
	  and floating point does not belong in a display work queue handler.
	  Under 100 bytes of RAM.

config NEXUS_BREAKOUT_BALL_SPEED
	int "Breakout ball speed, hundredths of a pixel per tick"
	default 350
	depends on NEXUS_BREAKOUT
	help
	  350 is 3.5 pixels a tick, about 125 px/s at the default tick rate.

	  Hundredths rather than whole pixels because whole pixels would only
	  offer 1, 2 and 3 - the difference between sedate and unplayable with
	  nothing usable in between.

	  Keep it under about half the paddle height per tick or the ball can
	  cross the paddle inside one step and be missed entirely.

config NEXUS_BREAKOUT_TICK_MS
	int "Breakout simulation interval, ms"
	default 28
	depends on NEXUS_BREAKOUT
	help
	  Lower is smoother and faster. The ball moves BALL_SPEED per tick, so
	  halving this doubles its speed as well - change one or the other,
	  not both at once.

config NEXUS_SETTINGS_PERSIST
	bool "Remember sound, theme and brightness across restarts"
	default y
	depends on SETTINGS
	help
	  Without this the Settings screen edits only the running session and
	  everything returns to its Kconfig default at the next power-on,
	  which reads as the screen not having worked.

	  Saving is explicit, from the SAVE row. Section 107's reasoning about
	  high scores applies here too: settings writes hit flash, and cycling
	  through seven themes should not cost seven erase cycles.

config NEXUS_SETTINGS_AUTOSAVE_MS
	int "Quiet period before a deferred save commits, ms"
	default 4000
	depends on NEXUS_SETTINGS_PERSIST
	help
	  Used by controls that fire repeatedly during one gesture - an
	  encoder emits a detent per click. The value applies instantly; only
	  the flash write waits for you to stop turning, so spinning through
	  seven themes costs one erase cycle instead of seven.

config NEXUS_GAME_HIGHSCORE_PERSIST
	bool "Persist high scores through Zephyr settings"
	default y
	depends on NEXUS_GAMES && SETTINGS

# --------------------------------------------------------------------------
# Status sources
# --------------------------------------------------------------------------
config NEXUS_ANTI_IDLE_STATUS
	bool "Show a mouse-jiggler indicator on the dashboard"
	default n
	help
	  Subscribes to zmk_anti_idle_state and lights a cursor icon on the
	  LINK card while the jiggler is on.

	  Off by default because the behavior that raises that event is not
	  part of NEXUS - it comes from the snake-module ZMK module. Enable
	  this only in a build that has it, or the include will not resolve.
	  A jiggler you cannot see the state of is a jiggler you leave running
	  into a meeting, which is the whole reason for the indicator.

config NEXUS_SPLIT_SWAP_SIDES
	bool "Swap which peripheral slot is labelled LEFT"
	default n
	help
	  ZMK numbers peripherals by pairing order, not by physical side. Flip
	  this if your dashboard shows the halves the wrong way round.

config NEXUS_SOUND_SETTLE_MS
	int "Ignore connection changes for the first N ms after boot"
	default 8000
	depends on NEXUS_SOUND
	help
	  Bringing up a keyboard is not a quiet process. Both halves
	  connect, and ZMK's central may drop and retry a link while it does
	  service discovery, so the first few seconds after a reset can produce
	  several link transitions that are all just "booting".

	  Announcing those gave two symptoms that looked unrelated: a couple of
	  random beeps a moment after every restart, and a splash fanfare that
	  only ever played on the first boot after flashing - the chirps were
	  cutting it off, because the sound engine plays the newest effect and
	  drops what was playing.

	  Must comfortably outlast NEXUS_SPLASH_DURATION_MS. The default gives
	  the 3.5 s splash room plus a few seconds for the links to settle.

config NEXUS_SOUND_SPLIT
	bool "Chirp when a half connects or disconnects, and on sleep/wake"
	depends on NEXUS_SOUND
	default y
	help
	  Four half cues (rising = arrived, falling = gone; left a fifth below
	  right) plus a slower pair for deep sleep and wake.

	  Nothing is played while the links are still settling after a reset;
	  see NEXUS_SOUND_SETTLE_MS.

	  Both directions are real events, not inference: they come from
	  Zephyr connection callbacks on the dongle's own BLE links, so a
	  half going away is announced immediately and a half merely dozing
	  between battery reports is not announced at all.

config NEXUS_STATUS_STALE_MS
	int "Blank a half's battery after N ms of silence (0 = never)"
	default 0
	help
	  Off by default, and that is deliberate. A half with CONFIG_ZMK_SLEEP
	  stops reporting battery when it goes idle, so any timeout here
	  eventually blanks a perfectly good reading and the dashboard shows
	  "--" for a keyboard that is working fine.

	  Section 26 wants "--" when the level is genuinely unavailable, not
	  when it is merely old: an idle half has a battery level, we just
	  heard it a while ago. Set a value only if you would rather see "--"
	  than a stale number.

# --------------------------------------------------------------------------
# Diagnostics
# --------------------------------------------------------------------------
config NEXUS_DEBUG
	bool "NEXUS debug build"
	default n
	help
	  Adds an FPS row to the Diagnostics screen, counted from frames the
	  compositor actually pushed. Off in production: the row repaints once
	  a second purely to show a number, and Section 65 is clear that idle
	  work on this device is not free.

	  For verbose logging set CONFIG_NEXUS_LOG_LEVEL_DBG=y as well, and
	  remember USB logging measurably raises power draw (Section 65).

module = NEXUS
module-str = nexus
source "subsys/logging/Kconfig.template.log_config"

endif # NEXUS
```

## boards/shields/nexus_dongle_demo/Kconfig.defconfig
```kconfig
if SHIELD_NEXUS_DONGLE_DEMO

config ZMK_KEYBOARD_NAME
	default "NEXUS Demo"

config ZMK_STUDIO
	default y

endif
```

## boards/shields/nexus_dongle_demo/Kconfig.shield
```kconfig
config SHIELD_NEXUS_DONGLE_DEMO
	def_bool $(shields_list_contains,nexus_dongle_demo)
```

## dts/bindings/behaviors/zmk,behavior-nexus-action.yaml
```yaml
description: Dispatch a NEXUS logical action from the keymap

compatible: "zmk,behavior-nexus-action"

include: one_param.yaml
```

## dts/bindings/nexus,button.yaml
```yaml
description: |
  NEXUS action button. Debounce, long-press and double-press are done in
  software (src/hal/nexus_button.c) so the timings are tunable per build.

compatible: "nexus,button"

include: base.yaml

properties:
  gpios:
    type: phandle-array
    required: true
```

## dts/bindings/nexus,buzzer.yaml
```yaml
description: |
  Passive buzzer driven from a PWM channel. The period in the pwms cell is a
  placeholder; the sound engine rewrites it per note.

compatible: "nexus,buzzer"

include: base.yaml

properties:
  pwms:
    type: phandle-array
    required: true
```
